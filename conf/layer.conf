## conf/layer.conf
```bitbake
# We have a conf and classes directory, add to BBPATH
BBPATH .= ":${LAYERDIR}"

# We have recipes-* directories, add to BBFILES
BBFILES += "${LAYERDIR}/recipes-*/*/*.bb \
            ${LAYERDIR}/recipes-*/*/*.bbappend"

BBFILE_COLLECTIONS += "yocto-sandbox"
BBFILE_PATTERN_yocto-sandbox = "^${LAYERDIR}/"
BBFILE_PRIORITY_yocto-sandbox = "11"

LAYERDEPENDS_yocto-sandbox = "core"
LAYERSERIES_COMPAT_yocto-sandbox = "scarthgap kirkstone styhead"
```
